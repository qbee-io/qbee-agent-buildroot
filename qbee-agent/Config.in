## qbee-agent/Config.in
```kconfig
config BR2_PACKAGE_QBEE_AGENT
	bool "qbee-agent"
	depends on BR2_PACKAGE_HOST_GO_TARGET_ARCH_SUPPORTS
	select BR2_PACKAGE_IPTABLES # runtime
	select BR2_PACKAGE_BUSYBOX_SHOW_OTHERS # runtime
	select BR2_PACKAGE_SHADOW # runtime
	select BR2_PACKAGE_BASH # runtime
	help
	  Qbee is a device management platform that comprise
	  of an open-source agent and a hosted SaaS backend.
	  This config installs pre-built static binaries made
	  with the official public signing key for qbee.io. The
	  binaries will work seamlessly with the qbee.io device
	  management backend.

	  https://github.com/qbee-io/qbee-agent
	  https://qbee.io
```
